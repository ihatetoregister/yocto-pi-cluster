## conf/local.conf
```bitbake
# Local configuration for Clusterhat Pi
# Yocto Project 3.1 Poky distribution [dunfell] branch

# mask wireguard from meta-openembedded/meta-networking
# use version in meta-jumpnow to support kernels < 5.6
# with wireguard-linux-compat
BBMASK = "meta-networking/recipes-kernel/wireguard"

LICENSE_FLAGS_WHITELIST = "commercial"

DISTRO_FEATURES = "ext2 opengl usbhost ${DISTRO_FEATURES_LIBC} systemd"

DISTRO_FEATURES_BACKFILL_CONSIDERED += "pulseaudio sysvinit"

PREFERRED_PROVIDER_jpeg = "libjpeg-turbo"
PREFERRED_PROVIDER_jpeg-native = "libjpeg-turbo-native"

PREFERRED_PROVIDER_udev = "eudev"
VIRTUAL-RUNTIME_init_manager = "systemd"
VIRTUAL-RUNTIME_initscripts = ""

IMX_DEFAULT_DISTRO_FEATURES_append = " systemd"

MACHINE_FEATURES_remove = "apm"

IMAGE_FSTYPES = "tar.xz"

# Choose the board you are building for
#MACHINE = "raspberrypi"
#MACHINE = "raspberrypi0"
#MACHINE = "raspberrypi0-wifi"
MACHINE = "raspberrypi2"
#MACHINE = "raspberrypi3"
#MACHINE = "raspberrypi4"
#MACHINE = "raspberrypi-cm"
#MACHINE = "raspberrypi-cm3"

# Choices are Image or zImage if NOT using u-boot (no u-boot is the default)
# Choices are uImage or zImage if using u-boot, though if you choose zImage
# with u-boot you will also have to change the boot script boot command
KERNEL_IMAGETYPE = "zImage"

# uncomment for kernels < 5.6
WIREGUARD_COMPAT = "1"

DISABLE_VC4GRAPHICS = "1"
DISABLE_OVERSCAN = "1"
ENABLE_UART = "1"
ENABLE_RPI3_SERIAL_CONSOLE = "1"
SERIAL_CONSOLES = "115200;ttyAMA0"
# SERIAL_CONSOLES_forcevariable = ""

# default is still 4.19, uncomment the following for 5.4
PREFERRED_VERSION_linux-raspberrypi = "5.4.%"


# DL_DIR = "/src/oe"
# SSTATE_DIR = "/oe6/rpi/sstate-cache"
# TMPDIR = "/oe6/rpi/tmp-dunfell"

DISTRO = "poky"
PACKAGE_CLASSES = "package_deb"

# i686 or x86_64
SDKMACHINE = "x86_64"

# for no root passwd uncomment the following and comment the two extra user lines
#EXTRA_IMAGE_FEATURES = "debug-tweaks"

# for a root passwd, change clusterhat below to your password
INHERIT += "extrausers"
EXTRA_USERS_PARAMS = "usermod -P clusterhat root; "

# this will force root to change password on first login
#INHERIT += "chageusers"
#CHAGE_USERS_PARAMS = "chage -d0 root; "

USER_CLASSES = "image-mklibs image-prelink"
PATCHRESOLVE = "noop"
RM_OLD_IMAGE = "1"
INHERIT += "rm_work"
CONF_VERSION = "1"

# Display config
HDMI_GROUP = "2"
HDMI_MODE = "82"

# Cluster CTRL and dependencies
#LICENSE_FLAGS_WHITELIST += " commercial"
IMAGE_INSTALL += " clusterctrl"

# Tools
#IMAGE_INSTALL += " lsusb"
IMAGE_INSTALL += " tree"

# Realtek wifi firmware
IMAGE_INSTALL += " linux-firmware-rtl8192cu"

# I2C driver
#KERNEL_MODULE_AUTOLOAD += " i2c-dev"
ENABLE_I2C = "1"
KERNEL_MODULE_AUTOLOAD_rpi += " i2c-dev i2c-bcm2708"


# Text editor
IMAGE_INSTALL += " nano"

# Package management
EXTRA_IMAGE_FEATURES += " package-management"
CORE_IMAGE_EXTRA_INSTALL += " apt"
IMAGE_INSTALL += " gnupg"

# Parallel
PARALLEL_MAKE = "-j 1"

BB_NUMBER_THREAD = "2"
```
